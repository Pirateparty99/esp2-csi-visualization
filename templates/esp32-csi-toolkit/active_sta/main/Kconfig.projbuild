## templates/esp32-csi-toolkit/active_sta/main/Kconfig.projbuild
```kconfig
menu "ESP32 CSI Tool Config"
    config WIFI_CHANNEL
        int "WiFi Channel"
        default 6
        help
            Select the WiFi channel of the AP. In North America, valid channels are {1,2,3,...,10,11}.
    config ESP_WIFI_SSID
        string "WiFi SSID"
        default "myssid"
        help
            SSID (network name) for the example to connect to.
    config ESP_WIFI_PASSWORD
        string "WiFi Password"
        default "mypassword"
        help
            WiFi password (WPA or WPA2) for the example to use.
    config STA_STATIC_IP_ENABLE
        bool "Enable static IP for STA mode"
        default n
        help
            Only relevant if this ESP32 is compiled as a station (active_sta)
            rather than an AP. Leave disabled for AP-mode boards.
    config STA_IP_ADDR
        string "STA Static IP Address"
        depends on STA_STATIC_IP_ENABLE
        default "192.168.4.20"
    config STA_GATEWAY_ADDR
        string "STA Gateway Address"
        depends on STA_STATIC_IP_ENABLE
        default "192.168.4.1"
    config STA_NETMASK_ADDR
        string "STA Netmask"
        depends on STA_STATIC_IP_ENABLE
        default "255.255.255.0"
    config STA_HOSTNAME
        string "STA Hostname"
        default "esp32-csi-node"
        help
            mDNS/DHCP hostname advertised by this device.
    config PACKET_RATE
        int "Packet TX Rate"
        default "100"
        help
            By transmitting at some number of packets per second, the ESP32 should receive CSI at the same rate.
            However, this is not guaranteed depending on overhead such as Serial baud rate.
            Minimum value: 1, Maximum value: 1000
    config SHOULD_COLLECT_CSI
        bool "Should this ESP32 collect and print CSI data?"
        default "n"
        help
            Allowing only a single ESP32 to collect CSI will likely increase the sampling frequency of your experiments.
    config SHOULD_COLLECT_ONLY_LLTF
        depends on SHOULD_COLLECT_CSI
        bool "(Advanced users only) Should we only collect LLTF?"
        default "y"
        help
            Each CSI frame can contain CSI either calculated through
            (1) legacy long training field (LLTF),
            (2) high throughput LTF (HT-LTF) and/or
            (3) space-time block code HT-LTF (STBC-HT-LTF).
            However, not all CSI frames have HT-LTF or STBC-HT-LTF while all CSI frame have LLTF.
            For beginners collecting only LLTF is the best option while advanced users can handle issues such as
            (1) HT-LTF or STBC-HT-LTF being missing, and
            (2) possible decreases in sampling rate due to serial connection saturation.
            [Advanced Users]: I cannot always help with these advanced issues,
            but if you have ideas on improvements to these issues please share!
    config SEND_CSI_TO_SERIAL
        depends on SHOULD_COLLECT_CSI
        bool "Send CSI data to Serial"
        default "y"
        help
            Sending data through serial (to a computer) can take time and buffer space.
            If you are storing to an SD card, it may be useful to deselect this option.
    config SEND_CSI_TO_SD
        depends on SHOULD_COLLECT_CSI
        bool "Send CSI data to SD"
        default "n"
        help
            Sending data to an SD card can take time and buffer space.
            If your ESP32 does not have an SD card, there is no reason to use this feature.
            If you do though, the program will be recognize this and not attempt writing to the SD card.
    config SEND_CSI_TO_UDP
        depends on SHOULD_COLLECT_CSI
        bool "Send CSI data to UDP"
        default "n"
        help
            Sends CSI data as JSON over UDP.
    config UDP_TARGET_IP
        depends on SEND_CSI_TO_UDP
        string "UDP target IP address"
        default "192.168.4.1"
        help
            IP address of the target host machine or router to forward UDP CSI data to.
    config UDP_TARGET_PORT
        depends on SEND_CSI_TO_UDP
        int "UDP target port"
        default 5566
        help
            UDP port to forward CSI data on.
    config CHANNEL_SURVEY
        bool "Log a 2.4GHz channel survey at boot"
        default "y"
        help
            Scans all channels once at startup and logs how many APs sit on
            each, the strongest signal per channel, and which of 1/6/11 looks
            quietest allowing for 20MHz overlap.

            Advisory only -- the channel is never changed. CSI is frequency
            dependent, so a baseline captured on one channel is meaningless on
            another, and node-to-node links need every node on the same
            channel. Use this to choose a channel at deployment, pin it on the
            AP and in WIFI_CHANNEL, then recalibrate.

            Runs before associating and adds roughly a second to boot.
    config CSI_PROMISCUOUS
        depends on SHOULD_COLLECT_CSI
        bool "Also capture CSI from other nodes' frames"
        default "y"
        help
            Associated as a station, a node normally only produces CSI for
            frames the AP sends it, which yields a star of node<->AP links.

            Enabling promiscuous capture additionally records CSI from other
            nodes' uplink frames on the same channel, adding node<->node
            links without any extra transmissions -- the traffic each node
            already sends to the AP is what its neighbours measure.

            Every reading carries "node" (observer) and "mac" (transmitter),
            so the two link types are distinguishable at the collector.

            Costs: the CSI callback fires for all data frames on the channel,
            including other networks, so expect a much higher capture rate.
            SEND_CSI_TO_UDP is rate limited, and the collector can filter on
            "mac" to keep only known nodes.
endmenu
```

## templates/esp32-csi-toolkit/passive/main/Kconfig.projbuild
```kconfig
menu "ESP32 CSI Tool Config"

    config WIFI_CHANNEL
        int "WiFi Channel"
        default 11
        help
            Select the WiFi channel to listen to passively. In North America, valid channels are {1,2,3,...,10,11}.

    config SHOULD_COLLECT_CSI
        bool "Should this ESP32 collect and print CSI data?"
        default "y"
        help
            Allowing only a single ESP32 to collect CSI will likely increase the sampling frequency of your experiments.

    config SHOULD_COLLECT_ONLY_LLTF
        depends on SHOULD_COLLECT_CSI
        bool "(Advanced users only) Should we only collect LLTF?"
        default "y"
        help
            Each CSI frame can contain CSI either calculated through
            (1) legacy long training field (LLTF),
            (2) high throughput LTF (HT-LTF) and/or
            (3) space-time block code HT-LTF (STBC-HT-LTF).
            However, not all CSI frames have HT-LTF or STBC-HT-LTF while all CSI frame have LLTF.
            For beginners collecting only LLTF is the best option while advanced users can handle issues such as
            (1) HT-LTF or STBC-HT-LTF being missing, and
            (2) possible decreases in sampling rate due to serial connection saturation.
            [Advanced Users]: I cannot always help with these advanced issues,
            but if you have ideas on improvements to these issues please share!

    config SEND_CSI_TO_SERIAL
        depends on SHOULD_COLLECT_CSI
        bool "Send CSI data to Serial"
        default "y"
        help
            Sending data through serial (to a computer) can take time and buffer space.
            If you are storing to an SD card, it may be useful to deselect this option.

    config SEND_CSI_TO_SD
        depends on SHOULD_COLLECT_CSI
        bool "Send CSI data to SD"
        default "n"
        help
            Sending data to an SD card can take time and buffer space.
            If your ESP32 does not have an SD card, there is no reason to use this feature.
            If you do though, the program will be recognize this and not attempt writing to the SD card.

    config PASSIVE_UPLINK
        bool "Associate to an AP so CSI can be reported over UDP"
        default "y"
        help
            A sniffer in WIFI_MODE_NULL has no IP and therefore no way to
            report anything off-device except over serial or to an SD card.
            Enabling this associates as a station purely to carry the UDP
            uplink; the node still never generates traffic for others to
            measure, so it stays receive-only for sensing purposes.

            Trade-off: an associated station follows its AP's channel, so
            WIFI_CHANNEL is no longer free and must match the AP. Disable this
            to keep WIFI_MODE_NULL and the ability to sniff any channel,
            including ones with no AP at all.

    config ESP_WIFI_SSID
        depends on PASSIVE_UPLINK
        string "WiFi SSID"
        default "myssid"
        help
            SSID of the AP to associate with for the UDP uplink.

    config ESP_WIFI_PASSWORD
        depends on PASSIVE_UPLINK
        string "WiFi Password"
        default "mypassword"

    config CHANNEL_SURVEY
        depends on PASSIVE_UPLINK
        bool "Log a 2.4GHz channel survey at boot"
        default "y"
        help
            Scans all channels once at startup and logs how busy each is.
            Advisory only; the channel is never changed.

    config SEND_CSI_TO_UDP
        depends on PASSIVE_UPLINK && SHOULD_COLLECT_CSI
        bool "Send CSI data to UDP"
        default "y"
        help
            Sends CSI data as JSON over UDP to UDP_TARGET_IP:UDP_TARGET_PORT.

    config UDP_TARGET_IP
        depends on SEND_CSI_TO_UDP
        string "UDP target IP address"
        default "192.168.4.1"
        help
            IP address of the collector, as seen from this node's network.

    config UDP_TARGET_PORT
        depends on SEND_CSI_TO_UDP
        int "UDP target port"
        default 5566
endmenu
```
