## templates/esp32-csi-toolkit/active_ap/main/Kconfig.projbuild
```kconfig
menu "ESP32 CSI Tool Config"
    config WIFI_CHANNEL
        int "WiFi Channel"
        default 6
        help
            Select the WiFi channel for the AP to communicate on. In North America, valid channels are {1,2,3,...,10,11}.
    config ESP_WIFI_SSID
        string "WiFi SSID"
        default "myssid"
        help
            SSID (network name) for the example to connect to.
    config ESP_WIFI_PASSWORD
        string "WiFi Password"
        default "mypassword"
        help
            WiFi password (WPA or WPA2) for the example to use.
    config AP_HOSTNAME
        string "AP Hostname"
        default "esp32-csi-ap"
        help
            Hostname this ESP32 advertises for its AP-mode interface.
    config AP_IP_ADDR
        string "AP IP Address"
        default "192.168.4.1"
        help
            Static IP address assigned to this ESP32 in AP mode.
            NOTE: if you change this, UDP_TARGET_IP below and your
            WiFi-3D-Fusion fusion.yaml config must be updated to match
            the new subnet.
    config AP_NETMASK
        string "AP Netmask"
        default "255.255.255.0"
    config AP_DHCP_LEASE_START
        string "AP DHCP Lease Start"
        default "192.168.4.100"
        help
            First IP address handed out to connecting stations.
    config AP_DHCP_LEASE_END
        string "AP DHCP Lease End"
        default "192.168.4.190"
    
    config SHOULD_COLLECT_CSI
        bool "Should this ESP32 collect and print CSI data?"
        default "y"
        help
            Allowing only a single ESP32 to collect CSI will likely increase the sampling frequency of your experiments.
    config SHOULD_COLLECT_ONLY_LLTF
        depends on SHOULD_COLLECT_CSI
        bool "(Advanced users only) Should we only collect LLTF?"
        default "y"
        help
            Each CSI frame can contain CSI either calculated through
            (1) legacy long training field (LLTF),
            (2) high throughput LTF (HT-LTF) and/or
            (3) space-time block code HT-LTF (STBC-HT-LTF).
            However, not all CSI frames have HT-LTF or STBC-HT-LTF while all CSI frame have LLTF.
            For beginners collecting only LLTF is the best option while advanced users can handle issues such as
            (1) HT-LTF or STBC-HT-LTF being missing, and
            (2) possible decreases in sampling rate due to serial connection saturation.
            [Advanced Users]: I cannot always help with these advanced issues,
            but if you have ideas on improvements to these issues please share!
    config SEND_CSI_TO_SERIAL
        depends on SHOULD_COLLECT_CSI
        bool "Send CSI data to Serial"
        default "y"
        help
            Sending data through serial (to a computer) can take time and buffer space.
    config SEND_CSI_TO_SD
        depends on SHOULD_COLLECT_CSI
        bool "Send CSI data to SD"
        default "n"
        help
            Sending data to an SD card can take time and buffer space.
            If your ESP32 does not have an SD card, there is no reason to use this feature.
            If you do though, the program will be recognize this and not attempt writing to the SD card.
    config SEND_CSI_TO_UDP
        depends on SHOULD_COLLECT_CSI
        bool "Send CSI data to UDP (WiFi-3D-Fusion compatible)"
        default "n"
        help
            Sends CSI data as JSON over UDP, matching the payload format expected
            by WiFi-3D-Fusion's esp32_udp.py receiver. In AP mode, UDP_TARGET_IP
            should be the IP address your host PC receives after joining this
            ESP32's own AP network (typically in the 192.168.4.x range).
    config UDP_TARGET_IP
        depends on SEND_CSI_TO_UDP
        string "UDP target IP address"
        default "192.168.4.1"
        help
            IP address of the host machine running WiFi-3D-Fusion, as seen on
            this ESP32's own AP subnet.
    config UDP_TARGET_PORT
        depends on SEND_CSI_TO_UDP
        int "UDP target port"
        default 5566
        help
            UDP port WiFi-3D-Fusion's esp32_udp.py listens on (must match
            esp32_udp_port in configs/fusion.yaml).
endmenu
```

## templates/esp32-csi-toolkit/wifi-mesh/main/Kconfig.projbuild
```kconfig
menu "ESP32 CSI Mesh Config"
    config WIFI_CHANNEL
        int "WiFi Channel"
        default 6
        help
            Select the WiFi channel of the AP. In North America, valid channels are {1,2,3,...,10,11}.
    config ESP_WIFI_SSID
        string "WiFi SSID"
        default "myssid"
        help
            SSID (network name) for the example to connect to.
    config ESP_WIFI_PASSWORD
        string "WiFi Password"
        default "mypassword"
        help
            WiFi password (WPA or WPA2) for the example to use.
    config STA_STATIC_IP_ENABLE
        bool "Enable static IP for STA mode"
        default n
        help
            Only relevant if this ESP32 is compiled as a station (active_sta)
            rather than an AP. Leave disabled for AP-mode boards.
    config STA_IP_ADDR
        string "STA Static IP Address"
        depends on STA_STATIC_IP_ENABLE
        default "192.168.4.20"
    config STA_GATEWAY_ADDR
        string "STA Gateway Address"
        depends on STA_STATIC_IP_ENABLE
        default "192.168.4.1"
    config STA_NETMASK_ADDR
        string "STA Netmask"
        depends on STA_STATIC_IP_ENABLE
        default "255.255.255.0"
    config STA_HOSTNAME
        string "STA Hostname"
        default "esp32-csi-node"
        help
            mDNS/DHCP hostname advertised by this device.
    config PACKET_RATE
        int "Packet TX Rate"
        default "100"
        help
            By transmitting at some number of packets per second, the ESP32 should receive CSI at the same rate.
            However, this is not guaranteed depending on overhead such as Serial baud rate.
            Minimum value: 1, Maximum value: 1000
    config SHOULD_COLLECT_CSI
        bool "Should this ESP32 collect and print CSI data?"
        default "n"
        help
            Allowing only a single ESP32 to collect CSI will likely increase the sampling frequency of your experiments.
    config SHOULD_COLLECT_ONLY_LLTF
        depends on SHOULD_COLLECT_CSI
        bool "(Advanced users only) Should we only collect LLTF?"
        default "y"
        help
            Each CSI frame can contain CSI either calculated through
            (1) legacy long training field (LLTF),
            (2) high throughput LTF (HT-LTF) and/or
            (3) space-time block code HT-LTF (STBC-HT-LTF).
            However, not all CSI frames have HT-LTF or STBC-HT-LTF while all CSI frame have LLTF.
            For beginners collecting only LLTF is the best option while advanced users can handle issues such as
            (1) HT-LTF or STBC-HT-LTF being missing, and
            (2) possible decreases in sampling rate due to serial connection saturation.
            [Advanced Users]: I cannot always help with these advanced issues,
            but if you have ideas on improvements to these issues please share!
    config SEND_CSI_TO_SERIAL
        depends on SHOULD_COLLECT_CSI
        bool "Send CSI data to Serial"
        default "y"
        help
            Sending data through serial (to a computer) can take time and buffer space.
            If you are storing to an SD card, it may be useful to deselect this option.
    config SEND_CSI_TO_SD
        depends on SHOULD_COLLECT_CSI
        bool "Send CSI data to SD"
        default "n"
        help
            Sending data to an SD card can take time and buffer space.
            If your ESP32 does not have an SD card, there is no reason to use this feature.
            If you do though, the program will be recognize this and not attempt writing to the SD card.
    config SEND_CSI_TO_UDP
        depends on SHOULD_COLLECT_CSI
        bool "Send CSI data to UDP"
        default "n"
        help
            Sends CSI data as JSON over UDP.
    config MESH_ID
        string "Mesh Network ID (6 bytes, hex)"
        default "77:77:77:77:77:77"
    config MESH_MAX_LAYER
        int "Maximum mesh layer depth"
        default 6
    config MESH_ROUTER_SSID
        string "Mesh root uplink SSID (external router, if any)"
        default ""
        help
            Leave blank to run in no-router / standalone mesh mode.
    config MESH_ROUTER_PASSWORD
        string "Mesh root uplink password"
        default ""
    config MESH_AP_PASSWORD
        string "Mesh internal AP password (node-to-node auth)"
        default "meshpass123"
    config SEND_CSI_TO_MESH
        depends on SHOULD_COLLECT_CSI
        bool "Send CSI data over ESP-MESH to root node"
        default "y"
        help
            Relays CSI data through the mesh network to the root node,
            which forwards it via UDP. Mutually exclusive with
            SEND_CSI_TO_UDP -- a mesh node doesn't have a direct route
            to the host PC itself.
    config UDP_TARGET_IP
        depends on SEND_CSI_TO_UDP || SEND_CSI_TO_MESH
        string "UDP target IP address"
        default "192.168.4.1"
        help
            For SEND_CSI_TO_UDP: IP address of the host machine, as seen on
            this ESP32's own AP subnet.
            For SEND_CSI_TO_MESH: IP address the mesh root node forwards
            received CSI data to via UDP.
    config UDP_TARGET_PORT
        depends on SEND_CSI_TO_UDP || SEND_CSI_TO_MESH
        int "UDP target port"
        default 5566
        help
            UDP port to forward CSI data on.
endmenu
```

## templates/wifi-mesh/main/Kconfig.projbuild
```kconfig
menu "ESP32 CSI Mesh Config"
    config MESH_ID
        string "Mesh Network ID (6 bytes, hex)"
        default "77:77:77:77:77:77"
    config MESH_MAX_LAYER
        int "Maximum mesh layer depth"
        default 6
    config MESH_ROUTER_SSID
        string "Mesh root uplink SSID (external router, if any)"
        default ""
        help
            Leave blank to run in no-router / standalone mesh mode.
    config MESH_ROUTER_PASSWORD
        string "Mesh root uplink password"
        default ""
    config MESH_AP_PASSWORD
        string "Mesh internal AP password (node-to-node auth)"
        default "meshpass123"
endmenu
```
